/dts-v1/;
#include "nucleo_h503rb-common.dtsi"


/ {
	model = "STMicroelectronics H503RB-NUCLEO board";
	compatible = "st,stm32h503rb-nucleo";

	#address-cells = <1>;
	#size-cells = <1>;

	chosen {
		zephyr,console = &usart3;
		zephyr,shell-uart = &usart3;
		zephyr,sram = &sram0;
		zephyr,flash = &flash0;
	};

	aliases {
		watchdog0 = &iwdg;
		volt-sensor0 = &vref;
		volt-sensor1 = &vbat;
	};
};
