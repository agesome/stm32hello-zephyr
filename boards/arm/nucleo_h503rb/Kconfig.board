## boards/arm/nucleo_h503rb/Kconfig.board
```kconfig
config BOARD_NUCLEO_H503RB
	bool "Nucleo H503RB Development Board"
	depends on SOC_STM32H503XX
```

## boards/arm/nucleo_h503rb/nucleo_h503rb_defconfig
```kconfig
CONFIG_SOC_SERIES_STM32H5X=y
CONFIG_SOC_STM32H503XX=y

CONFIG_SERIAL=y
CONFIG_CONSOLE=y
CONFIG_UART_CONSOLE=y
CONFIG_STDOUT_CONSOLE=y
CONFIG_EARLY_CONSOLE=y

CONFIG_CLOCK_CONTROL=y
CONFIG_ARM_MPU=y
CONFIG_HW_STACK_PROTECTION=y

CONFIG_GPIO=y
CONFIG_PINCTRL=y

CONFIG_SYS_CLOCK_HW_CYCLES_PER_SEC=240000000
```
